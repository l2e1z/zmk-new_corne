## KConfig
```kconfig
config ZMK_BEHAVIOR_MASK_MODS
    bool
    default y
    depends on DT_HAS_ZMK_BEHAVIOR_MASK_MODS_ENABLED
    
```

## config/west.yml
```yaml
manifest:
  remotes:
    - name: zmkfirmware
      url-base: https://github.com/zmkfirmware
    - name: cormoran
      url-base: https://github.com/cormoran
  projects:
    - name: eyelash_corne
      url: https://github.com/a741725193/zmk-new_corne
      revision: main
    - name: zmk
      remote: cormoran
      revision: 4493783ef88ce2e653bf8217c92ee17140df71e3
      import: app/west.yml
    - name: zmk-behavior-runtime-sensor-rotate
      remote: cormoran
      revision: main
    - name: zmk-module-ble-management
      remote: cormoran
      revision: zmk-v0.3.0.0
    - name: zmk-module-battery-history
      remote: cormoran
      revision: main
    - name: zmk-module-settings-rpc
      remote: cormoran
      revision: main
    - name: zmk-module-runtime-input-processor
      remote: cormoran
      revision: zmk-v0.3.0.0
  self:
    path: config
```

## dts/bindings/behaviors/zmk,behavior-bt-select-disconnect.yaml
```yaml
# Copyright (c) 2026
# SPDX-License-Identifier: MIT

description: Select a Bluetooth profile and disconnect all other connected profiles

compatible: "zmk,behavior-bt-select-disconnect"

include: one_param.yaml
```

## dts/bindings/behaviors/zmk,behavior-mask-mods.yaml
```yaml
# Copyright (c) 2026
# SPDX-License-Identifier: MIT

description: Mask modifiers while invoking another behavior

compatible: "zmk,behavior-mask-mods"

include: zero_param.yaml

properties:
  bindings:
    type: phandle-array
    required: true

  mods:
    type: int
    required: true
```
